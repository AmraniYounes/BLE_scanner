## build/Kconfig/arch/Kconfig
```kconfig
# Load Zephyr Arch Kconfig descriptions.
osource "/home/younesam/zephyrproject/zephyr/arch/rx/Kconfig"
osource "/home/younesam/zephyrproject/zephyr/arch/x86/Kconfig"
osource "/home/younesam/zephyrproject/zephyr/arch/xtensa/Kconfig"
osource "/home/younesam/zephyrproject/zephyr/arch/sparc/Kconfig"
osource "/home/younesam/zephyrproject/zephyr/arch/riscv/Kconfig"
osource "/home/younesam/zephyrproject/zephyr/arch/posix/Kconfig"
osource "/home/younesam/zephyrproject/zephyr/arch/mips/Kconfig"
osource "/home/younesam/zephyrproject/zephyr/arch/arm64/Kconfig"
osource "/home/younesam/zephyrproject/zephyr/arch/arm/Kconfig"
osource "/home/younesam/zephyrproject/zephyr/arch/arc/Kconfig"
```

## build/Kconfig/boards/Kconfig.defconfig
```kconfig
# Load Zephyr board defconfig descriptions.
osource "/home/younesam/zephyrproject/zephyr/boards/espressif/esp32_devkitc/Kconfig.defconfig"
```

## build/Kconfig/boards/Kconfig.esp32c3_devkitc
```kconfig
# Load board Kconfig descriptions.
osource "/home/younesam/zephyrproject/zephyr/boards/espressif/esp32c3_devkitc/Kconfig.esp32c3_devkitc"
```

## build/Kconfig/boards/Kconfig.sysbuild
```kconfig
# Load Sysbuild board Kconfig descriptions.
osource "/home/younesam/zephyrproject/zephyr/boards/espressif/esp32c3_devkitc/Kconfig.sysbuild"
```
